## sdkconfig.defaults.wg1200
```kconfig
# WeatherXM WG1200 Gateway configuration overrides
CONFIG_LCD_BOARD_SENSECAP_INDICATOR_WXM=y
# CONFIG_LCD_BOARD_SENSECAP_INDICATOR_D1L is not set
CONFIG_ESPTOOLPY_FLASHSIZE_16MB=y
# CONFIG_ESPTOOLPY_FLASHSIZE_8MB is not set
CONFIG_PARTITION_TABLE_CUSTOM=y
CONFIG_PARTITION_TABLE_CUSTOM_FILENAME="partitions_wg1200.csv"
CONFIG_PARTITION_TABLE_FILENAME="partitions_wg1200.csv"
CONFIG_PARTITION_TABLE_OFFSET=0xc000

# Long Filename support for FATFS on SD card
CONFIG_FATFS_LFN_HEAP=y
CONFIG_FATFS_MAX_LFN=255
```
